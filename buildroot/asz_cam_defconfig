## buildroot/asz_cam_defconfig
```kconfig
# ASZ Cam OS - Buildroot Configuration
# Configuración personalizada para Raspberry Pi

BR2_arm=y
BR2_cortex_a72=y
BR2_ARM_FPU_NEON_VFPV4=y

# Sistema base
BR2_SYSTEM_HOSTNAME="aszcam"
BR2_SYSTEM_BANNER="Welcome to ASZ Cam OS"
BR2_TARGET_GENERIC_HOSTNAME="aszcam"
BR2_TARGET_GENERIC_ISSUE="ASZ Cam OS - Ready to capture memories"

# Kernel y bootloader para Raspberry Pi 4
BR2_LINUX_KERNEL=y
BR2_LINUX_KERNEL_CUSTOM_TARBALL=y
BR2_LINUX_KERNEL_CUSTOM_TARBALL_LOCATION="$(call github,raspberrypi,linux,rpi-5.15.y)/linux-rpi-5.15.y.tar.gz"
BR2_LINUX_KERNEL_DEFCONFIG="bcm2711"
BR2_LINUX_KERNEL_DTS_SUPPORT=y
BR2_LINUX_KERNEL_INTREE_DTS_NAME="bcm2711-rpi-4-b bcm2711-rpi-cm4-io"

# Bootloader
BR2_TARGET_UBOOT=y
BR2_TARGET_UBOOT_BUILD_SYSTEM_KCONFIG=y
BR2_TARGET_UBOOT_CUSTOM_GIT=y
BR2_TARGET_UBOOT_CUSTOM_REPO_URL="https://github.com/u-boot/u-boot"
BR2_TARGET_UBOOT_BOARD_DEFCONFIG="rpi_4"

# Toolchain
BR2_TOOLCHAIN_EXTERNAL=y
BR2_TOOLCHAIN_EXTERNAL_ARM_ARM=y

# Filesystem
BR2_TARGET_ROOTFS_EXT2=y
BR2_TARGET_ROOTFS_EXT2_4=y
BR2_TARGET_ROOTFS_EXT2_SIZE="512M"

# Packages para ASZ Cam OS
BR2_PACKAGE_PYTHON3=y
BR2_PACKAGE_PYTHON3_PYQT5=y
BR2_PACKAGE_PYTHON_OPENCV3=y
BR2_PACKAGE_PYTHON_REQUESTS=y
BR2_PACKAGE_PYTHON_PILLOW=y
BR2_PACKAGE_PYTHON_NUMPY=y

# libcamera support
BR2_PACKAGE_LIBCAMERA=y
BR2_PACKAGE_LIBCAMERA_PIPELINE_IPU3=y
BR2_PACKAGE_LIBCAMERA_PIPELINE_RASPBERRYPI=y
BR2_PACKAGE_LIBCAMERA_PIPELINE_VIMC=y

# V4L2 utilities
BR2_PACKAGE_V4L_UTILS=y

# Network support
BR2_PACKAGE_DHCPCD=y
BR2_PACKAGE_WPA_SUPPLICANT=y
BR2_PACKAGE_WIRELESS_TOOLS=y

# Display and GPU
BR2_PACKAGE_RPI_FIRMWARE=y
BR2_PACKAGE_RPI_GPU_FW=y
BR2_PACKAGE_MESA3D=y
BR2_PACKAGE_MESA3D_GALLIUM_DRIVER_VC4=y
BR2_PACKAGE_MESA3D_OPENGL_EGL=y
BR2_PACKAGE_MESA3D_OPENGL_ES=y

# Qt5 support
BR2_PACKAGE_QT5=y
BR2_PACKAGE_QT5BASE=y
BR2_PACKAGE_QT5BASE_OPENGL_ES2=y
BR2_PACKAGE_QT5BASE_FONTCONFIG=y
BR2_PACKAGE_QT5BASE_GUI=y
BR2_PACKAGE_QT5BASE_WIDGETS=y

# Audio (optional)
BR2_PACKAGE_ALSA_UTILS=y

# Development tools (can be removed for production)
BR2_PACKAGE_GDB=y
BR2_PACKAGE_STRACE=y

# Custom packages for ASZ Cam OS
BR2_ROOTFS_OVERLAY="board/asz-cam/overlay"
BR2_ROOTFS_POST_BUILD_SCRIPT="board/asz-cam/post-build.sh"
BR2_ROOTFS_POST_IMAGE_SCRIPT="board/asz-cam/post-image.sh"

# Target options
BR2_TARGET_OPTIMIZATION="-Os"
BR2_ENABLE_LOCALE_PURGE=y
BR2_ENABLE_LOCALE_WHITELIST="C en_US es_ES"
```

## buildroot/aszcam_defconfig
```kconfig
# ASZ Cam OS Buildroot Configuration
# Custom configuration for Raspberry Pi based camera system

# Target architecture
BR2_arm=y
BR2_cortex_a72=y
BR2_ARM_FPU_NEON_VFPV4=y

# System configuration
BR2_SYSTEM_HOSTNAME="aszcam"
BR2_SYSTEM_BANNER="Welcome to ASZ Cam OS"
BR2_TARGET_GENERIC_GETTY_PORT="console"
BR2_SYSTEM_INIT_SYSTEMD=y

# Toolchain
BR2_TOOLCHAIN_BUILDROOT_GLIBC=y
BR2_TOOLCHAIN_BUILDROOT_CXX=y

# Kernel
BR2_LINUX_KERNEL=y
BR2_LINUX_KERNEL_CUSTOM_VERSION=y
BR2_LINUX_KERNEL_CUSTOM_VERSION_VALUE="6.1.21"
BR2_LINUX_KERNEL_DEFCONFIG="bcm2711"
BR2_LINUX_KERNEL_CONFIG_FRAGMENT_FILES="$(BR2_EXTERNAL_ASZCAM_PATH)/kernel/aszcam.config"
BR2_LINUX_KERNEL_DTS_SUPPORT=y
BR2_LINUX_KERNEL_INTREE_DTS_NAME="bcm2711-rpi-4-b"

# Bootloader
BR2_TARGET_RPI_FIRMWARE=y

# Filesystem
BR2_TARGET_ROOTFS_EXT2=y
BR2_TARGET_ROOTFS_EXT2_4=y
BR2_TARGET_ROOTFS_EXT2_SIZE="2G"

# Core packages for camera functionality
BR2_PACKAGE_OPENCV4=y
BR2_PACKAGE_OPENCV4_LIB_PYTHON3=y
BR2_PACKAGE_PYTHON3=y
BR2_PACKAGE_PYTHON_PIP=y
BR2_PACKAGE_GSTREAMER1=y
BR2_PACKAGE_GST1_PLUGINS_BASE=y
BR2_PACKAGE_GST1_PLUGINS_GOOD=y
BR2_PACKAGE_LIBCAMERA=y
BR2_PACKAGE_LIBCAMERA_PIPELINE_RPI=y

# Qt5 for UI
BR2_PACKAGE_QT5=y
BR2_PACKAGE_QT5BASE=y
BR2_PACKAGE_QT5BASE_GUI=y
BR2_PACKAGE_QT5BASE_WIDGETS=y

# Network support
BR2_PACKAGE_WPA_SUPPLICANT=y
BR2_PACKAGE_WIRELESS_TOOLS=y
BR2_PACKAGE_DHCPCD=y

# Additional utilities
BR2_PACKAGE_BUSYBOX_CONFIG="$(BR2_EXTERNAL_ASZCAM_PATH)/configs/busybox.config"
BR2_PACKAGE_DROPBEAR=y
BR2_PACKAGE_NANO=y
```
